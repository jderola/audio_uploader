## sdkconfig.defaults
```kconfig
CONFIG_IDF_TARGET="esp32s3"

# Wi-Fi
CONFIG_ESP_WIFI_ENABLED=y

# FATFS
CONFIG_FATFS_VOLUME_COUNT=2
CONFIG_FATFS_LFN_HEAP=y

# TLS certificate bundle
CONFIG_MBEDTLS_CERTIFICATE_BUNDLE=y
CONFIG_MBEDTLS_CERTIFICATE_BUNDLE_DEFAULT_FULL=y

# Performance
CONFIG_COMPILER_OPTIMIZATION_PERF=y

# USB Host
CONFIG_USB_HOST_CONTROL_TRANSFER_MAX_SIZE=256

# Console
CONFIG_ESP_CONSOLE_UART_DEFAULT=y
```
